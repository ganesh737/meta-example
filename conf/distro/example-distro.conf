## conf/distro/example-distro.conf
```bitbake
MAINTAINER = "ganesh <ganesh.rvec@gmail.com>"

require conf/distro/poky.conf

DISTRO = "example-distro"
DISTRO_NAME = "example distro"
DISTRO_VERSION = "1.0"
DISTRO_CODENAME = "example"
SDK_VENDOR = "-exampledistro"
SDK_VERSION = "sdkversion"

# configure package management
EXTRA_IMAGE_FEATURES += "package-management"
PACKAGE_CLASSES_append = " package_ipk "
IMAGE_INSTALL_append = " opkg "
PRSERV_HOST = "localhost:0"
PACKAGE_FEED_URIS = "http://192.168.0.108:8080"
PACKAGE_FEED_BASE_PATHS = ""
PACKAGE_FEED_ARCHS = "cortexa7t2hf-neon-vfpv4"

# set hostname
hostname_pn-base-files = "example"

# update to systemd init instead of sysvinit
DISTRO_FEATURES_append = " systemd opengl"
VIRTUAL-RUNTIME_init_manager = "systemd"
DISTRO_FEATURES_remove += "sysvinit"
VIRTUAL-RUNTIME_initscripts = "systemd-compat-units"
DISTRO_FEATURES_BACKFILL_CONSIDERED = "sysvinit"

# remove unused features
DISTRO_FEATURES_remove += " bluetool ext2 irda pcmcia pci 3g nfc x11 multiarch wayland pulseaudio bluez5"

# set the default timezone
DEFAULT_TIMEZONE = "Asia/Kolkata"
```
